## apps/uart_rx/build/Kconfig/Kconfig.shield
```kconfig
osource "D:/Desktop/source/uart_tutorial/apps/uart_rx/../..//boards/shields/*/Kconfig.shield"
```

## apps/uart_tx/build/Kconfig/Kconfig.shield
```kconfig
osource "D:/Desktop/source/uart_tutorial/apps/uart_tx/../..//boards/shields/*/Kconfig.shield"
```
